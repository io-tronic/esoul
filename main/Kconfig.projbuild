## main/Kconfig.projbuild
```kconfig
menu "Esoul Configuration"
    config ESOUL_AUDIO_REC_TIME
        int "Number of seconds for each audio recording"
        default 30
        help
            Set the time for recording audio in seconds.

    config ESOUL_CAMERA_REC_TIME
        int "Number of seconds to wait between photos"
        default 15
        help
            Set the time for recording audio in seconds.

    menu "SD SPI Configuration"

        config ESOUL_FORMAT_IF_MOUNT_FAILED
            bool "Format the card if mount failed"
            default n
            help
                If this config item is set, format_if_mount_failed will be set to true and the card will be formatted if
                the mount has failed.


        config ESOUL_PIN_MOSI
            int "MOSI GPIO number"
            default 15 if IDF_TARGET_ESP32
            default 35 if IDF_TARGET_ESP32S2
            default 9 if IDF_TARGET_ESP32S3
            default 5  if IDF_TARGET_ESP32H2
            default 11 if IDF_TARGET_ESP32P4
            default 4  # C3 and others

        config ESOUL_PIN_MISO
            int "MISO GPIO number"
            default 2 if IDF_TARGET_ESP32
            default 37 if IDF_TARGET_ESP32S2
            default 8 if IDF_TARGET_ESP32S3
            default 0  if IDF_TARGET_ESP32H2
            default 13 if IDF_TARGET_ESP32P4
            default 6  # C3 and others

        config ESOUL_PIN_CLK
            int "CLK GPIO number"
            default 14 if IDF_TARGET_ESP32
            default 36 if IDF_TARGET_ESP32S2
            default 7 if IDF_TARGET_ESP32S3
            default 4  if IDF_TARGET_ESP32H2
            default 12 if IDF_TARGET_ESP32P4
            default 5  # C3 and others

        config ESOUL_PIN_CS
            int "CS GPIO number"
            default 13 if IDF_TARGET_ESP32
            default 34 if IDF_TARGET_ESP32S2
            default 21 if IDF_TARGET_ESP32S3
            default 10 if IDF_TARGET_ESP32P4
            default 1  # C3 and others

    endmenu

    menu "Audio recording configuration"

        menu "I2S MEMS MIC Configuration"

            config ESOUL_SAMPLE_RATE
                int "Audio Sample Rate"
                default 16000
                help
                    Set the audio sample rate frequency. Usually 16000 or 44100 Hz.

            config ESOUL_BIT_SAMPLE
                int "Audio Bit Sample"
                default 16
                help
                    Define the number of bits for each sample. Default 16 bits per sample.

            config ESOUL_I2S_DATA_GPIO
                int "I2S Data GPIO"
                default 41
                help
                    Set the GPIO number used for transmitting/receiving data from I2S.

            config ESOUL_I2S_CLK_GPIO
                int "I2S Clock GPIO"
                default 42
                help
                    Set the GPIO number used for the clock line from I2S.

        endmenu

    endmenu
endmenu
```
